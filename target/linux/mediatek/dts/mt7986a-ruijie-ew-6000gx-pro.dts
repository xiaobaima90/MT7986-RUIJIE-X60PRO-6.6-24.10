// SPDX-License-Identifier: GPL-2.0-or-later OR MIT

/dts-v1/;
#include "mt7986a-ruijie-ew-6000gx-pro.dtsi"

/ {
	compatible = "ruijie,ew-6000gx-pro", "mediatek,mt7986a";
 	model = "Ruijie EW-6000GX Pro";
};

&partitions {
 	partition@680000 {
 		label = "ubi";
 		reg = <0x680000 0x6b00000>;
 	};
};