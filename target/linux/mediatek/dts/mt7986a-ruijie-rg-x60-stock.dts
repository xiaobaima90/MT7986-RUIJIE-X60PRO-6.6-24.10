// SPDX-License-Identifier: GPL-2.0-or-later OR MIT

/dts-v1/;
#include "mt7986a-ruijie-rg-x60.dtsi"

/ {
	compatible = "ruijie,rg-x60-stock", "mediatek,mt7986a";
 	model = "Ruijie RG-X60 (Stock)";
};

&partitions {
 	partition@680000 {
 		label = "ubi";
 		reg = <0x680000 0x3f00000>;
 	};
};