// SPDX-License-Identifier: GPL-2.0-or-later OR MIT

/dts-v1/;
#include "mt7986a-ruijie-ew-6000gx-pro.dtsi"
#include "mt7986a-ruijie-ubi-107m.dtsi"

/ {
	compatible = "ruijie,ew-6000gx-pro-107m", "mediatek,mt7986a";
	model = "Ruijie EW-6000GX Pro (107m)";
};
