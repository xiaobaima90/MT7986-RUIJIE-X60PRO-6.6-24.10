// SPDX-License-Identifier: GPL-2.0-or-later OR MIT

/dts-v1/;
#include "mt7986a-ruijie-rg-x60.dtsi"
#include "mt7986a-ruijie-ubi-expand.dtsi"

/ {
	compatible = "ruijie,rg-x60", "mediatek,mt7986a";
 	model = "Ruijie RG-X60";
};

&partitions {
 	partition@680000 {
 		label = "ubi";
 		reg = <0x680000 0x6b00000>;
 	};
};